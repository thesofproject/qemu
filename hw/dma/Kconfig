## hw/dma/Kconfig
```kconfig
config RC4030
    bool

config PL080
    bool

config PL330
    bool

config I82374
    bool
    select I8257

config I8257
    bool

config ZYNQ_DEVCFG
    bool
    select REGISTER

config STP2000
    bool

config DW_DMA_DSP
    bool

config DW_DMA_PCI
    bool

config HDA_DMA_DSP
    bool

config EDMA_DSP
    bool

config SDMA_DSP
    bool
```
